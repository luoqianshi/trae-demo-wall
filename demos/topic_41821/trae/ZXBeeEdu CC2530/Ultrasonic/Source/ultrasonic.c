/*********************************************************************************************
* 文件：ultrasonic.c
* 作者：Dengcy 2015.1.27
* 说明：超声波测距驱动程序
*       通过P0_1和P0_5端口控制传感器的工作
* 修改：
* 注释：
*********************************************************************************************/

/*********************************************************************************************
* 头文件
*********************************************************************************************/
#include <ioCC2530.h>
#include "hal_mcu.h"
#include "ultrasonic.h"

/*********************************************************************************************
* 宏定义
*********************************************************************************************/
#define   PIN_EN_CFG      (P0SEL &= ~0x20, P0DIR |= 0x20)
#define   PIN_ECHO_CFG    (P0SEL &= ~0x02, P0DIR &=~0x02)
#define   WAVE_EN_PIN     P0_5
#define   WAVE_INPUT_PIN  P0_1

/*********************************************************************************************
* 全局变量
*********************************************************************************************/
static char clkidx;
static unsigned int clk;
static unsigned clks[] = {32000, 16000, 8000, 4000, 2000, 1000, 500, 250};

#pragma optimize=none
/*********************************************************************************************
* 名称：Delay_10us()
* 功能：延时
* 参数：无
* 返回：无
* 修改：
* 注释：
*********************************************************************************************/
void Delay_10us(void)
{ 
  unsigned short i;
  for(i=0;i<100;i++)
  {
    asm("NOP");
  }
}

/*********************************************************************************************
* 名称：ultrasonic_init()
* 功能：超声波测距传感器初始化
* 参数：无
* 返回：无
* 修改：
* 注释：
*********************************************************************************************/
void ultrasonic_init(void)
{
  PIN_EN_CFG;
  PIN_ECHO_CFG;
  
  WAVE_EN_PIN = 0;
  
  clkidx = (CLKCONCMD>>3)&0x07;
  
  clk = (clks[clkidx]/128);
}

/*********************************************************************************************
* 名称：ultrasonic_start()
* 功能：触发测距
* 参数：无
* 返回：无
* 修改：
* 注释：
*********************************************************************************************/
static void ultrasonic_start(void)
{
  WAVE_EN_PIN = 1;
  Delay_10us();
  Delay_10us();
  WAVE_EN_PIN = 0;
}

#pragma optimize=none
/*********************************************************************************************
* 名称：ultrasonic_distance()
* 功能：计算距离
* 参数：无
* 返回：无
* 修改：
* 注释：
*********************************************************************************************/
float ultrasonic_distance(void)
{
  int i = 0;
  float cnt = 0;
  float d;  
  
  T1CNTL = 0x00;
  T1CNTH = 0x00;
  ultrasonic_start();
  while ((0 == WAVE_INPUT_PIN) && ++i);
  if (i == 0) return -1;
  T1CTL = 0x0D; //128div

  i = 0;
  while (WAVE_INPUT_PIN && ++i);
  T1CTL = 0x00;
  if (i == 0) return -1;
  
  cnt = (T1CNTH<<8) | (T1CNTL);
  d = (float)((cnt) / clk * 17);
  
  return d;
}

